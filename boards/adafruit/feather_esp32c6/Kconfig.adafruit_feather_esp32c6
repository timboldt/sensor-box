## boards/adafruit/feather_esp32c6/board.yml
```yaml
board:
  name: adafruit_feather_esp32c6
  full_name: Adafruit Feather ESP32-C6
  vendor: adafruit
  socs:
    - name: esp32c6
```

## drivers/sensor/pmsa003i/Kconfig
```kconfig
# Plantower PMSA003I particulate matter sensor

# SPDX-License-Identifier: MIT

config PMSA003I
	bool "Plantower PMSA003I particulate matter sensor"
	default y
	depends on DT_HAS_PLANTOWER_PMSA003I_ENABLED
	select I2C
	help
	  Enable driver for the Plantower PMSA003I I2C particulate matter
	  sensor (PM1.0 / PM2.5 / PM10 mass concentration and particle counts).
```

## drivers/sensor/sgp30/Kconfig
```kconfig
# Sensirion SGP30 indoor air quality sensor

# SPDX-License-Identifier: MIT

config SGP30
	bool "Sensirion SGP30 eCO2 / TVOC sensor"
	default y
	depends on DT_HAS_SENSIRION_SGP30_ENABLED
	select I2C
	select CRC
	help
	  Enable driver for the Sensirion SGP30 indoor air quality sensor.
	  The driver runs the mandatory 1 Hz measurement cadence itself using
	  a delayable work item on the system workqueue.
```
